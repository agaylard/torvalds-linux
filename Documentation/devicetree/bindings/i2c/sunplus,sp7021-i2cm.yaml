## Documentation/devicetree/bindings/i2c/sunplus,sp7021-i2cm.yaml
```yaml
# SPDX-License-Identifier: (GPL-2.0-only OR BSD-2-Clause)
%YAML 1.2
---
$id: http://devicetree.org/schemas/i2c/sunplus,sp7021-i2cm.yaml#
$schema: http://devicetree.org/meta-schemas/core.yaml#

title: Sunplus SP7021 I2C master controller

maintainers:
  - Andrew Gaylard <ag@ffroot.co.za>
  - Li-hao Kuo <lhjeff911@gmail.com>

description:
  The SP7021 has four I2C master controllers. Each controller has its own
  DMA engine, which reads and writes the transfer data in memory. The DMA
  engines of all four controllers also need the clock of controller 0 to be
  on and its reset to be released, so every controller has that clock and
  reset as a second entry, named "dma". Controller 0 names its own clock
  and reset there.

allOf:
  - $ref: /schemas/i2c/i2c-controller.yaml#

properties:
  compatible:
    const: sunplus,sp7021-i2cm

  reg:
    maxItems: 1

  interrupts:
    maxItems: 1

  clocks:
    items:
      - description: Controller clock
      - description: Clock of controller 0, used by the DMA engine

  clock-names:
    items:
      - const: core
      - const: dma

  resets:
    items:
      - description: Controller reset
      - description: Reset of controller 0, used by the DMA engine

  reset-names:
    items:
      - const: core
      - const: dma

  clock-frequency:
    minimum: 13184
    maximum: 400000

required:
  - compatible
  - reg
  - interrupts
  - clocks
  - clock-names
  - resets
  - reset-names

unevaluatedProperties: false

examples:
  - |
    #include <dt-bindings/clock/sunplus,sp7021-clkc.h>
    #include <dt-bindings/interrupt-controller/irq.h>
    #include <dt-bindings/reset/sunplus,sp7021-reset.h>

    i2c@9c004700 {
        compatible = "sunplus,sp7021-i2cm";
        reg = <0x9c004700 0x100>;
        interrupts = <175 IRQ_TYPE_LEVEL_HIGH>;
        clocks = <&clkc CLK_I2CM1>, <&clkc CLK_I2CM0>;
        clock-names = "core", "dma";
        resets = <&rstc RST_I2CM1>, <&rstc RST_I2CM0>;
        reset-names = "core", "dma";
        clock-frequency = <100000>;
        pinctrl-names = "default";
        pinctrl-0 = <&i2cm1_pins>;
        #address-cells = <1>;
        #size-cells = <0>;

        eeprom@50 {
            compatible = "atmel,24c04";
            reg = <0x50>;
        };
    };
...
```

## Documentation/devicetree/bindings/mmc/sunplus,sp7021-sd.yaml
```yaml
# SPDX-License-Identifier: (GPL-2.0-only OR BSD-2-Clause)
# Copyright (C) Sunplus Technology Co., Ltd.
%YAML 1.2
---
$id: http://devicetree.org/schemas/mmc/sunplus,sp7021-sd.yaml#
$schema: http://devicetree.org/meta-schemas/core.yaml#

title: Sunplus SP7021 SD/SDIO host controller

description:
  The SP7021 has two identical SD/SDIO host controllers. A controller runs
  in SDIO mode when its node has both no-sd and no-mmc, otherwise it runs
  in SD mode, which supports SD and MMC cards but not SDIO cards.

maintainers:
  - Andrew Gaylard <ag@ffroot.co.za>

allOf:
  - $ref: mmc-controller.yaml#

properties:
  compatible:
    const: sunplus,sp7021-sd

  reg:
    maxItems: 1

  interrupts:
    maxItems: 1

  clocks:
    maxItems: 1

  resets:
    maxItems: 1

  bus-width:
    enum: [1, 4]

required:
  - compatible
  - reg
  - interrupts
  - clocks
  - resets

unevaluatedProperties: false

examples:
  - |
    #include <dt-bindings/clock/sunplus,sp7021-clkc.h>
    #include <dt-bindings/gpio/gpio.h>
    #include <dt-bindings/interrupt-controller/irq.h>
    #include <dt-bindings/reset/sunplus,sp7021-reset.h>

    mmc@9c003e80 {
        compatible = "sunplus,sp7021-sd";
        reg = <0x9c003e80 0x280>;
        interrupts = <21 IRQ_TYPE_LEVEL_HIGH>;
        clocks = <&clkc CLK_CARD_CTL1>;
        resets = <&rstc RST_CARD_CTL1>;
        pinctrl-names = "default";
        pinctrl-0 = <&sdcard_pins>;
        bus-width = <4>;
        max-frequency = <50000000>;
        disable-wp;
        cap-sd-highspeed;
        no-sdio;
        no-mmc;
        cd-gpios = <&pctl 0 GPIO_ACTIVE_LOW>;
    };

  - |
    #include <dt-bindings/clock/sunplus,sp7021-clkc.h>
    #include <dt-bindings/interrupt-controller/irq.h>
    #include <dt-bindings/reset/sunplus,sp7021-reset.h>

    mmc@9c008400 {
        compatible = "sunplus,sp7021-sd";
        reg = <0x9c008400 0x280>;
        interrupts = <22 IRQ_TYPE_LEVEL_HIGH>;
        clocks = <&clkc CLK_CARD_CTL4>;
        resets = <&rstc RST_CARD_CTL4>;
        bus-width = <4>;
        max-frequency = <50000000>;
        non-removable;
        no-sd;
        no-mmc;
    };
...
```
