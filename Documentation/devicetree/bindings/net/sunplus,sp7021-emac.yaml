## Documentation/devicetree/bindings/net/sunplus,sp7021-emac.yaml
```yaml
# SPDX-License-Identifier: (GPL-2.0-only OR BSD-2-Clause)
# Copyright (C) Sunplus Co., Ltd. 2021
%YAML 1.2
---
$id: http://devicetree.org/schemas/net/sunplus,sp7021-emac.yaml#
$schema: http://devicetree.org/meta-schemas/core.yaml#

title: Sunplus SP7021 Dual Ethernet MAC

maintainers:
  - Wells Lu <wellslutw@gmail.com>

description: |
  Sunplus SP7021 dual 10M/100M Ethernet MAC controller.
  Device node of the controller has following properties.

properties:
  compatible:
    const: sunplus,sp7021-emac

  reg:
    maxItems: 1

  interrupts:
    maxItems: 1

  clocks:
    items:
      - description: L2SW AXI gate clock
      - description: PLLE 25 MHz output (MII 100M)
      - description: PLLE 2.5 MHz output (MII 10M)
      - description: PLLE 112.5 MHz output (MAC fabric)

  clock-names:
    items:
      - const: l2sw
      - const: plle-25
      - const: plle-2p5
      - const: plle-112p5

  resets:
    maxItems: 1

  ethernet-ports:
    type: object
    additionalProperties: false
    description:
      Ethernet ports, each connected to a PHY or, as a fixed link, to another
      MAC

    properties:
      "#address-cells":
        const: 1

      "#size-cells":
        const: 0

    patternProperties:
      "^port@[0-1]$":
        type: object
        $ref: ethernet-controller.yaml#
        unevaluatedProperties: false
        description: Ethernet port, connected to either a PHY or a fixed-link MAC

        properties:
          reg:
            minimum: 0
            maximum: 1

          phy-handle:
            maxItems: 1

          phy-mode:
            maxItems: 1

          nvmem-cells:
            items:
              - description: nvmem cell address of MAC address

          nvmem-cell-names:
            description: names corresponding to the nvmem cells
            items:
              - const: mac-address

          fixed-link:
            $ref: ethernet-controller.yaml#/properties/fixed-link
            type: object
            properties:
              speed:
                enum: [10, 100]

        required:
          - reg
          - phy-mode
          - nvmem-cells
          - nvmem-cell-names

        oneOf:
          - required:
              - phy-handle
          - required:
              - fixed-link

  mdio:
    $ref: mdio.yaml#
    unevaluatedProperties: false

additionalProperties: false

required:
  - compatible
  - reg
  - interrupts
  - clocks
  - clock-names
  - resets
  - pinctrl-0
  - pinctrl-names
  - ethernet-ports
  - mdio

examples:
  - |
    #include <dt-bindings/clock/sunplus,sp7021-clkc.h>
    #include <dt-bindings/interrupt-controller/irq.h>
    #include <dt-bindings/reset/sunplus,sp7021-reset.h>

    ethernet@9c108000 {
        compatible = "sunplus,sp7021-emac";
        reg = <0x9c108000 0x400>;
        interrupt-parent = <&intc>;
        interrupts = <66 IRQ_TYPE_LEVEL_HIGH>;
        clocks = <&clkc CLK_L2SW>, <&clkc PLL_E_25>, <&clkc PLL_E_2P5>, <&clkc PLL_E_112P5>;
        clock-names = "l2sw", "plle-25", "plle-2p5", "plle-112p5";
        resets = <&rstc RST_L2SW>;
        pinctrl-0 = <&emac_demo_board_v3_pins>;
        pinctrl-names = "default";

        ethernet-ports {
            #address-cells = <1>;
            #size-cells = <0>;

            port@0 {
                reg = <0>;
                phy-handle = <&eth_phy0>;
                phy-mode = "rmii";
                nvmem-cells = <&mac_addr0>;
                nvmem-cell-names = "mac-address";
            };

            port@1 {
                reg = <1>;
                phy-mode = "rmii";
                nvmem-cells = <&mac_addr1>;
                nvmem-cell-names = "mac-address";

                fixed-link {
                    speed = <100>;
                    full-duplex;
                };
            };
        };

        mdio {
            #address-cells = <1>;
            #size-cells = <0>;

            eth_phy0: ethernet-phy@0 {
                reg = <0>;
            };
        };
    };
...
```
